/**
 * @file chain_speed_dump.cpp
 * @brief Host golden-vector dump for `ChainSpeedPolicy.h` (ADR-059, T4).
 *
 * Includes the pure, Arduino-free `ChainSpeedPolicy.h` header PLUS the REAL firmware
 * `Config::PWM_MIN_MAGNITUDE` / `Config::PWM_MAX` / `Config::TSHAPE_ACCEL_PWM_PER_CM` /
 * `Config::TSHAPE_MIN_MOVE_CM` / `Config::TSHAPE_START_SPEED` / `Config::SPEED_NORMAL` constants
 * (`WRO2026/config/ConfigGlobal.h` + `WRO2026/config/ConfigDrive.h` — both pure
 * `<stdint.h>`-only `constexpr`, no Arduino surface, so they are directly host-includable with
 * zero mocking). For a curated set of `(hopDist[], cruise, entry)` vectors it calls
 * `resolveChainSpeeds` once and prints the resolved per-hop `(startPwm, endPwm, brake)` as JSON
 * on stdout.
 *
 * This binary is DELIBERATELY not a self-asserting ctest target — see
 * `chain_speed_freshness.cmake`, which drives it twice (once to a temp file, once already
 * committed as `tools/path_planner/tests/fixtures/chain_speed_goldens.json`) and byte-compares
 * the two. That comparison IS the ctest — the "executable tether": a firmware retune that
 * changes `Config::TSHAPE_ACCEL_PWM_PER_CM` / `PWM_MIN_MAGNITUDE` or a change to the policy math
 * changes this program's stdout, which then diverges from the committed fixture and fails CI
 * until the fixture is regenerated. The Python mirror `chain_speed.py` (T5) reads the SAME
 * fixture and asserts byte-identity (AC6 / TC1).
 *
 * JSON precision (load-bearing): every float column (`cruise`? no — cruise/entry are int PWM;
 * only the per-hop `hopDist` values are float) is printed with `%.9g` — enough decimal digits
 * that a `float` -> ASCII -> `float`/`numpy.float32` round trip reproduces the EXACT same 32-bit
 * pattern (9 significant digits is the documented upper bound for a `float`'s round-trip
 * guarantee). We never widen to `double` math before printing.
 *
 * Line endings (cross-OS, load-bearing): stdout is forced into BINARY mode on Windows/MSVC
 * (`_setmode(_fileno(stdout), _O_BINARY)`) so every `\n` this program writes stays a bare LF
 * instead of being translated to CRLF by the C runtime's default text-mode stdout. That keeps
 * the generated bytes byte-identical on Windows, macOS, and Linux, so the committed fixture
 * (git-normalized to LF via `.gitattributes: *.json text eol=lf`) byte-matches a fresh Windows
 * run and the `chain_speed_freshness` gate stays green on every teammate's OS. On POSIX the
 * `_setmode` call is a no-op, so the guard is Windows-only.
 *
 * JSON shape (`tools/path_planner/tests/fixtures/chain_speed_goldens.json`):
 *   [
 *     { "label": <string>, "hopDist": [<float>, ...], "hopCount": <int>,
 *       "cruise": <int>, "entry": <int>,
 *       "out": [ {"startPwm": <int>, "endPwm": <int>, "brake": <bool>}, ... ] },
 *     ...
 *   ]
 * The `hopCount < 2` (single-hop) vector emits an EMPTY `out` array — the policy leaves the
 * caller's buffer untouched, so the dump reflects "not a chain: caller takes the ordinary path"
 * (TC1's single-hop rejection). Its `out` is emitted empty to make that explicit to the mirror.
 */

#include <cstdio>
#include <string>
#include <vector>

// Windows/MSVC only: pull in `_setmode` / `_fileno` / `_O_BINARY` so main() can force stdout
// into binary mode (see the file-level "Line endings" note). Guarded by `_WIN32` so the POSIX
// build (g++ / clang on Linux + macOS) never sees these headers.
#if defined(_WIN32)
#include <fcntl.h>
#include <io.h>
#endif

#include "../../config/ConfigDrive.h"
#include "../../config/ConfigGlobal.h"
#include "../../src/drive/ChainSpeedPolicy.h"

namespace
{
    /** @brief Compile-time cap on the per-vector hop count (matches the policy's node buffer). */
    constexpr size_t MAX_HOPS = 16;

    /**
     * @brief One golden-vector input: a curated hop-distance list plus the run cruise + entry.
     */
    struct GoldenCase
    {
        const char*        label;    ///< Human-readable regime tag (emitted for readability).
        std::vector<float> hopDist;  ///< Per-hop distances (cm).
        int16_t            cruise;   ///< Signed run cruise PWM.
        int16_t            entry;    ///< Signed entry PWM (captured cruise, else start seed).
    };

    /**
     * @brief Format a `float` as a JSON number with enough precision to round-trip the exact
     *        32-bit value. `%.9g` mirrors the `FLT_DECIMAL_DIG == 9` round-trip bound.
     */
    std::string floatToJson(float v)
    {
        char buf[48];
        std::snprintf(buf, sizeof(buf), "%.9g", static_cast<double>(v));
        return std::string(buf);
    }

    /**
     * @brief Build the curated golden-vector set. Coverage (see the T4 task spec / TC1):
     *   - even chain [10,10,10]                 -> cruise plateau through the run, floor at end.
     *   - short FINAL hop [10,10,3]             -> shed pulled into the prior hop (node2 = 65).
     *   - short MID hop [10,3,10]               -> mid hop too short to dip; stays at cruise.
     *   - reverse cruise [10,10,10]             -> negative sign carried into every output.
     *   - entry == cruise [10,10,10]            -> AC5: no re-dip to floor at the run start.
     *   - single-hop [10] (hopCount < 2)        -> TC1 rejection: policy leaves `out` untouched.
     *   - long even chain [40,40,40]            -> accel/decel both fully fit; interior cruise.
     */
    std::vector<GoldenCase> buildGoldenCases()
    {
        using Config::SPEED_NORMAL;
        using Config::TSHAPE_START_SPEED;

        const int16_t cruise = SPEED_NORMAL;         // 85
        const int16_t start  = TSHAPE_START_SPEED;   // 50 (= PWM_MIN_MAGNITUDE)

        std::vector<GoldenCase> cases;

        cases.push_back({"even_chain_entry_start", {10.0f, 10.0f, 10.0f}, cruise, start});
        cases.push_back({"short_final_hop_entry_start", {10.0f, 10.0f, 3.0f}, cruise, start});
        cases.push_back({"short_mid_hop_entry_start", {10.0f, 3.0f, 10.0f}, cruise, start});
        cases.push_back({"reverse_cruise_entry_start",
                         {10.0f, 10.0f, 10.0f},
                         static_cast<int16_t>(-cruise),
                         static_cast<int16_t>(-start)});
        cases.push_back({"even_chain_entry_cruise", {10.0f, 10.0f, 10.0f}, cruise, cruise});
        cases.push_back({"single_hop_rejected", {10.0f}, cruise, start});
        cases.push_back({"long_even_chain_entry_start", {40.0f, 40.0f, 40.0f}, cruise, start});

        return cases;
    }

    /**
     * @brief Print one `GoldenCase` + its resolved per-hop `(startPwm, endPwm, brake)` array.
     *
     * A `hopCount < 2` vector never has `resolveChainSpeeds` fill `out`, so this pre-zeroes the
     * buffer and emits ONLY as many hops as the policy would touch (`hopCount >= 2`) — a
     * single-hop vector emits an empty `out`, making the "not a chain" contract explicit.
     */
    void printCase(const GoldenCase& c, bool isLast)
    {
        const ChainSpeedConfig cfg = {Config::PWM_MIN_MAGNITUDE,
                                      Config::PWM_MAX,
                                      Config::TSHAPE_ACCEL_PWM_PER_CM,
                                      Config::TSHAPE_MIN_MOVE_CM};

        const uint8_t hopCount = static_cast<uint8_t>(c.hopDist.size());

        // Sentinel-fill the output buffer so an UNtouched entry is visibly distinct from a real
        // resolved 0 — the single-hop vector must leave `out` untouched (TC1). We only ever
        // EMIT the entries the policy fills (hopCount >= 2), so the sentinel is a safety net, not
        // emitted data.
        ChainHopSpeed out[MAX_HOPS];
        for (size_t i = 0; i < MAX_HOPS; ++i)
        {
            out[i].startPwm = 0;
            out[i].endPwm   = 0;
            out[i].brake    = false;
        }

        resolveChainSpeeds(c.hopDist.data(), hopCount, c.cruise, c.entry, cfg, out);

        std::printf("  {\n");
        std::printf("    \"label\": \"%s\",\n", c.label);
        std::printf("    \"hopDist\": [");
        for (size_t i = 0; i < c.hopDist.size(); ++i)
        {
            std::printf("%s%s",
                        floatToJson(c.hopDist[i]).c_str(),
                        (i + 1 < c.hopDist.size()) ? ", " : "");
        }
        std::printf("],\n");
        std::printf("    \"hopCount\": %d,\n", static_cast<int>(hopCount));
        std::printf("    \"cruise\": %d,\n", static_cast<int>(c.cruise));
        std::printf("    \"entry\": %d,\n", static_cast<int>(c.entry));
        std::printf("    \"out\": [");

        // The policy fills `out[0..hopCount-1]` only when hopCount >= 2; a single-hop (or empty)
        // vector leaves it untouched, which we surface as an empty array.
        const size_t emitted = (hopCount >= 2) ? static_cast<size_t>(hopCount) : 0;
        if (emitted > 0)
        {
            std::printf("\n");
            for (size_t i = 0; i < emitted; ++i)
            {
                std::printf("      {\"startPwm\": %d, \"endPwm\": %d, \"brake\": %s}%s\n",
                            static_cast<int>(out[i].startPwm),
                            static_cast<int>(out[i].endPwm),
                            out[i].brake ? "true" : "false",
                            (i + 1 < emitted) ? "," : "");
            }
            std::printf("    ]\n");
        }
        else
        {
            std::printf("]\n");
        }
        std::printf("  }%s\n", isLast ? "" : ",");
    }
}    // namespace

int main()
{
#if defined(_WIN32)
    // Force stdout to binary so `\n` is emitted as a bare LF, not CRLF (cross-OS byte-identity
    // with the LF-normalized committed fixture — see the file-level "Line endings" note).
    _setmode(_fileno(stdout), _O_BINARY);
#endif

    const std::vector<GoldenCase> cases = buildGoldenCases();

    std::printf("[\n");
    for (size_t i = 0; i < cases.size(); ++i)
    {
        printCase(cases[i], i + 1 == cases.size());
    }
    std::printf("]\n");

    return 0;
}
